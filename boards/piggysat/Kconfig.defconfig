## boards/piggysat/Kconfig.defconfig
```kconfig
# SPDX-License-Identifier: Apache-2.0

config HW_STACK_PROTECTION
	default ARCH_HAS_STACK_PROTECTION

if BOARD_PIGGYSAT_NRF9151 || BOARD_PIGGYSAT_NRF9151_NS

config BOARD_PIGGYSAT
	select USE_DT_CODE_PARTITION if BOARD_PIGGYSAT_NRF9151_NS

endif # BOARD_PIGGYSAT_NRF9151 || BOARD_PIGGYSAT_NRF9151_NS
```

## boards/piggysat/Kconfig.piggysat
```kconfig
# SPDX-License-Identifier: Apache-2.0

config BOARD_PIGGYSAT
	select SOC_NRF9151_LACA
```

## boards/piggysat/board.yml
```yaml
# SPDX-License-Identifier: Apache-2.0

board:
  name: piggysat
  full_name: PiggySat
  socs:
  - name: nrf9151
    variants:
    - name: 'ns'
```

## boards/piggysat/dts/bindings/piggysat,antenna-switch.yaml
```yaml
# SPDX-License-Identifier: Apache-2.0

description: |
  PiggySat external antenna selection switch, connected through the J3 header.
  The header supplies 3Vcc and GND to the switch and drives its control line
  from a GPIO output. Inactive (low) routes the antenna to LTE, active (high)
  routes it to GNSS.

compatible: "piggysat,antenna-switch"

properties:
  gpios:
    type: phandle-array
    required: true
    description: GPIO driving the switch control line.
```

## piggysat-test/Kconfig
```kconfig
#
# Copyright (c) 2020 Nordic Semiconductor ASA
#
# SPDX-License-Identifier: LicenseRef-Nordic-5-Clause
#

menu "piggy_sat"

menu "LTE message test"

config APP_TELEMETRY_MESSAGE
	string "Telemetry message"
	default ""
	help
	  String placed in the "message" field of the telemetry JSON.

config APP_THINGSBOARD_HOST
	string "ThingsBoard host name or IP address"
	default ""
	help
	  Host name or literal IP address used for CoAP telemetry uploads to
	  ThingsBoard.

config APP_THINGSBOARD_IPV4
	string "ThingsBoard IPv4 address override"
	default ""
	help
	  Optional numeric IPv4 address used to bypass DNS resolution entirely.
	  When set, this address is used instead of APP_THINGSBOARD_HOST.

config APP_THINGSBOARD_PORT
	int "ThingsBoard CoAP port number"
	default 5683

config APP_THINGSBOARD_ACCESS_TOKEN
	string "ThingsBoard access token"
	default ""
	help
	  Access token inserted into the CoAP telemetry resource path
	  api/v1/<token>/telemetry.

config APP_COAP_ACK_TIMEOUT_MS
	int "CoAP initial ACK timeout in milliseconds"
	default 60000
	range 1000 100000
	help
	  Initial wait for the ACK of a confirmable CoAP request before it is
	  retransmitted. Each retransmission doubles the wait. NTN round trips
	  are long, so this is much higher than the CoAP default of 2 s to
	  avoid spending satellite airtime on needless retransmissions.

config APP_COAP_MAX_RETRANSMIT
	int "CoAP maximum retransmissions"
	default 2
	range 0 10
	help
	  Number of retransmissions of an unacknowledged telemetry request.
	  The application waits for the full retransmission sequence to end
	  before it counts the upload as failed.

config APP_LTE_ATTACH_TIMEOUT_SECONDS
	int "LTE attach timeout in seconds"
	default 600
	range 10 3600
	help
	  Maximum time the LTE message test waits for network registration
	  and PDN activation before giving up.

endmenu

menu "Modem and NTN"

config APP_APN
	string "APN for PDP context 0"
	default ""
	help
	  APN configured explicitly on the default PDP context before the modem
	  starts the network connection attempt.

config APP_MODEM_FW_EXPECTED
	string "Required modem firmware token"
	default "mfw_nrf9151-ntn"
	help
	  Substring that must be present in the modem firmware version returned
	  by AT+CGMR during boot. Leave empty to disable the boot-time firmware
	  compatibility check.

config APP_BAND_LOCK_LIST
	string "Band lock list"
	default "255,256"
	help
	  Comma-separated list of bands locked before the connection attempt.
	  For NTN operation, use NTN-only bands such as 255 and 256.

config APP_NTN_LATITUDE
	string "NTN latitude in degrees"
	default "45.4064"
	help
	  Fixed latitude given to the modem through ntn_location_set() for the
	  LTE message test. GNSS positions are not stored, so the modem needs a
	  configured location close to the real one to attach. The same location
	  is sent in the test message. Defaults to Padova, Italy.

config APP_NTN_LONGITUDE
	string "NTN longitude in degrees"
	default "11.8768"
	help
	  Fixed longitude given to the modem through ntn_location_set().

config APP_NTN_ALTITUDE_METERS
	string "NTN altitude in meters"
	default "12.0"
	help
	  Fixed altitude given to the modem through ntn_location_set().

config APP_NTN_LOCATION_VALIDITY_SECONDS
	int "NTN location validity in seconds"
	default 43200
	range 0 2147483647
	help
	  Validity parameter passed to ntn_location_set(). A value of 0 means
	  infinite validity.

config APP_PSM_ENABLE
	bool "Enable LTE Power Saving Mode (PSM)"
	select LTE_PSM_REQ

config APP_EDRX_ENABLE
	bool "Enable LTE enhanced Discontinuous Reception (eDRX)"
	select LTE_EDRX_REQ

endmenu

menu "LTE CW TX test"

config APP_CW_BAND
	int "CW test band"
	default 255
	help
	  3GPP band number passed to AT%XRFTEST.

config APP_CW_FREQUENCY_100KHZ
	int "CW test frequency in 100 kHz units"
	default 16435
	range 6000 22000
	help
	  Uplink frequency passed to AT%XRFTEST, in 100 kHz units. The default
	  16435 (1643.5 MHz) is the middle of the band 255 uplink. The CW tone is
	  offset from this frequency by the modem (48.75 kHz in NB-IoT mode).

config APP_CW_POWER_DBM
	int "CW test output power in dBm"
	default 23
	range -50 23
	help
	  Requested TX power at the SiP antenna port.

endmenu

endmenu

module = APP
module-str = piggy_sat
source "$(ZEPHYR_BASE)/subsys/logging/Kconfig.template.log_config"

menu "Zephyr Kernel"
source "Kconfig.zephyr"
endmenu
```
