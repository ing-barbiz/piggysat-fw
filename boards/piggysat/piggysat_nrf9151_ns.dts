/*
 * SPDX-License-Identifier: Apache-2.0
 */

/dts-v1/;
#include <arm/nordic/nrf9151_ns_laca.dtsi>
#include "piggysat_nrf9151_common.dtsi"

/ {
	chosen {
		zephyr,flash = &flash0;
		zephyr,sram = &sram0_ns_app;
		zephyr,code-partition = &slot0_ns_partition;
	};
};
