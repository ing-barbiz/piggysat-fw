## CMakeLists.txt
```
#
# SPDX-License-Identifier: Apache-2.0
#

cmake_minimum_required(VERSION 3.20.0)

# Local secrets (access token) live in a git-ignored file at the repository root, shared by the
# apps; see secrets.conf.example.
set(PIGGYSAT_SECRETS ${CMAKE_CURRENT_LIST_DIR}/../secrets.conf)
if(EXISTS ${PIGGYSAT_SECRETS})
  list(APPEND EXTRA_CONF_FILE ${PIGGYSAT_SECRETS})
else()
  message(WARNING "secrets.conf not found: CONFIG_APP_THINGSBOARD_ACCESS_TOKEN is empty "
                  "(copy secrets.conf.example to secrets.conf)")
endif()

find_package(Zephyr REQUIRED HINTS $ENV{ZEPHYR_BASE})
project(piggysat)

target_sources(app PRIVATE
	src/main.c
	src/antenna.c
	src/leds.c
	src/magnet.c
	src/gnss.c
	src/modem.c
	src/transport.c
)

zephyr_include_directories(src)

# Development: keep the debug port open so the debugger and RTT logs always work, even after a
# full chip erase (UICR "unprotected" values merged into tfm_merged.hex, see the board folder).
# Remove this for production firmware.
if(CONFIG_TFM_FLASH_MERGED_BINARY AND NOT CONFIG_PARTITION_MANAGER_ENABLED)
  set(TFM_MERGED_HEX ${CMAKE_BINARY_DIR}/zephyr/tfm_merged.hex)
  add_custom_target(uicr_debug_open ALL
    COMMAND ${PYTHON_EXECUTABLE} ${ZEPHYR_BASE}/scripts/build/mergehex.py --overlap=replace
            -o ${TFM_MERGED_HEX} ${TFM_MERGED_HEX}
            ${BOARD_DIR}/uicr_debug_open.hex
    COMMENT "Adding UICR debug-open values to tfm_merged.hex"
  )
  add_dependencies(uicr_debug_open zephyr_final)
endif()
```

## Kconfig
```
#
# SPDX-License-Identifier: Apache-2.0
#

menu "piggysat"

config APP_REPORT_INTERVAL_SECONDS
	int "Report interval in seconds"
	default 900
	range 60 86400
	help
	  Time between the start of two report cycles. If a cycle takes longer,
	  the next one starts immediately.

config APP_GNSS_FIX_TIMEOUT_SECONDS
	int "GNSS fix timeout in seconds"
	default 180
	range 10 3600
	help
	  Maximum time spent acquiring a fix in each cycle. Without a fix the
	  cycle is aborted: no connection and no message.

config APP_LTE_ATTACH_TIMEOUT_SECONDS
	int "NTN attach timeout in seconds"
	default 600
	range 10 3600

config APP_SENT_LED_ON_SECONDS
	int "Sent LED on-time in seconds"
	default 30

config APP_LED_BLINK_MS
	int "LED blink half period in milliseconds"
	default 250

menu "ThingsBoard"

config APP_TELEMETRY_MESSAGE
	string "Text in the message field"
	default "piggysat"

config APP_THINGSBOARD_HOST
	string "ThingsBoard host name or IP address"
	default "coap.thingsboard.cloud"

config APP_THINGSBOARD_IPV4
	string "ThingsBoard IPv4 address override"
	default ""
	help
	  Optional numeric IPv4 address that skips DNS resolution.

config APP_THINGSBOARD_PORT
	int "ThingsBoard CoAP port"
	default 5683

config APP_THINGSBOARD_ACCESS_TOKEN
	string "ThingsBoard device access token"
	default ""
	help
	  Set it in secrets.conf at the repository root (git-ignored).

config APP_COAP_ACK_TIMEOUT_MS
	int "CoAP initial ACK timeout in milliseconds"
	default 60000
	range 1000 100000

config APP_COAP_MAX_RETRANSMIT
	int "CoAP maximum retransmissions"
	default 2
	range 0 10

endmenu

menu "Modem and NTN"

config APP_APN
	string "APN for PDP context 0"
	default ""

config APP_MODEM_FW_EXPECTED
	string "Required modem firmware token"
	default "mfw_nrf9151-ntn"

config APP_BAND_LOCK_LIST
	string "NTN band lock list"
	default "255,256"

config APP_NTN_LOCATION_VALIDITY_SECONDS
	int "NTN location validity in seconds"
	default 43200

endmenu

endmenu

module = APP
module-str = piggysat
source "$(ZEPHYR_BASE)/subsys/logging/Kconfig.template.log_config"

menu "Zephyr Kernel"
source "Kconfig.zephyr"
endmenu
```

## prj.conf
```kconfig
#
# SPDX-License-Identifier: Apache-2.0
#

# TF-M
CONFIG_TFM_PROFILE_TYPE_MINIMAL=y

# General
CONFIG_PICOLIBC_IO_FLOAT=y
CONFIG_LOG=y
CONFIG_LOG_MODE_DEFERRED=y
CONFIG_LOG_DEFAULT_LEVEL=3
# Room for the satellite list logged every 3 s while searching
CONFIG_LOG_BUFFER_SIZE=4096
CONFIG_ASSERT=y
CONFIG_ASSERT_NO_COND_INFO=y
CONFIG_ASSERT_NO_MSG_INFO=y
CONFIG_HW_STACK_PROTECTION=y
CONFIG_RESET_ON_FATAL_ERROR=y

# Network (offloaded to the modem) and CoAP
CONFIG_NETWORKING=y
CONFIG_NET_NATIVE=n
CONFIG_NET_UDP=y
CONFIG_NET_SOCKETS=y
CONFIG_NET_SOCKETS_OFFLOAD=y
CONFIG_POSIX_API=y
CONFIG_COAP=y
CONFIG_COAP_CLIENT=y
CONFIG_COAP_CLIENT_STACK_SIZE=4096
CONFIG_COAP_CLIENT_MESSAGE_SIZE=384
CONFIG_COAP_CLIENT_MESSAGE_HEADER_SIZE=64
CONFIG_COAP_CLIENT_MAX_PATH_LENGTH=96

# Modem, LTE link control and NTN
CONFIG_NRF_MODEM_LIB=y
CONFIG_LTE_LINK_CONTROL=y
CONFIG_LTE_NETWORK_MODE_DEFAULT=y
CONFIG_LTE_LC_PDN_MODULE=y
CONFIG_NTN=y
CONFIG_AT_MONITOR_HEAP_SIZE=2048

# Kernel events (magnet.c)
CONFIG_EVENTS=y

# Heap and stacks
CONFIG_HEAP_MEM_POOL_SIZE=2048
CONFIG_MAIN_STACK_SIZE=8192
CONFIG_SYSTEM_WORKQUEUE_STACK_SIZE=2048

# Application
CONFIG_APP_REPORT_INTERVAL_SECONDS=900
CONFIG_APP_GNSS_FIX_TIMEOUT_SECONDS=180
CONFIG_APP_LTE_ATTACH_TIMEOUT_SECONDS=600
CONFIG_APP_SENT_LED_ON_SECONDS=30
CONFIG_APP_TELEMETRY_MESSAGE="piggysat"
CONFIG_APP_THINGSBOARD_HOST="coap.thingsboard.cloud"
CONFIG_APP_THINGSBOARD_PORT=5683
# Access token: set it in ../secrets.conf (git-ignored), see ../secrets.conf.example
CONFIG_APP_APN="go.mono"
CONFIG_APP_MODEM_FW_EXPECTED="mfw_nrf9151-ntn"
CONFIG_APP_BAND_LOCK_LIST="255,256"
```

## boards/piggysat_nrf9151_ns.conf
```kconfig
# SPDX-License-Identifier: Apache-2.0

# PiggySat: no UART, logs over RTT through the TC2030 SWD connector.
CONFIG_LOG_BACKEND_RTT=y
```

## src/main.c
```c
/*
 * SPDX-License-Identifier: Apache-2.0
 */

/* PiggySat: every CONFIG_APP_REPORT_INTERVAL_SECONDS
 *   1. acquire a GNSS fix                  (GNSS LED blinks); no fix: abort the cycle
 *   2. attach to NTN and send the position (LTE LED blinks)
 *   3. on success, sent LED on for CONFIG_APP_SENT_LED_ON_SECONDS
 *   4. detach and sleep with the modem off
 *
 * A magnet on the sensor stops everything: the running cycle is aborted and the
 * board stays in standby (modem off, LEDs off). Removing it starts a cycle at once.
 */

#include "app.h"

#include <errno.h>
#include <stdio.h>
#include <string.h>

#include <app_version.h>
#include <zephyr/logging/log.h>

LOG_MODULE_REGISTER(main, CONFIG_APP_LOG_LEVEL);

#define PAYLOAD_SIZE 256

/* Copies src into dst escaping '"' and '\' for a JSON string. */
static void json_escape(const char *src, char *dst, size_t size)
{
	size_t out = 0;

	for (; *src != '\0' && out + 2 < size; src++)
	{
		if (*src == '"' || *src == '\\')
		{
			dst[out++] = '\\';
		}
		dst[out++] = *src;
	}
	dst[out] = '\0';
}

static int build_payload(char *buf, size_t size, const struct gnss_fix *fix)
{
	char message[64];

	json_escape(CONFIG_APP_TELEMETRY_MESSAGE, message, sizeof(message));
	return snprintf(buf, size,
					"{\"message\":\"%s\",\"latitude\":%.6f,\"longitude\":%.6f,"
					"\"altitude\":%.1f,\"accuracy\":%.1f}",
					message, fix->latitude, fix->longitude, (double)fix->altitude,
					(double)fix->accuracy);
}

/* Attach, send, detach. Returns 0 when the server accepted the message. */
static int send_report(const char *payload, size_t len)
{
	int coap_class = 0;
	int coap_detail = 0;
	int err;

	led_blink(LED_LTE);

	err = lte_configure();
	if (!err)
	{
		err = lte_connect_start();
	}
	if (!err)
	{
		err = lte_wait_for_link(CONFIG_APP_LTE_ATTACH_TIMEOUT_SECONDS);
		if (err == -ETIMEDOUT)
		{
			LOG_WRN("LTE: no network within %d s", CONFIG_APP_LTE_ATTACH_TIMEOUT_SECONDS);
		}
	}
	if (!err)
	{
		LOG_INF("LTE: attached");
		lte_info_log();
		LOG_INF("LTE: sending");
		err = transport_send(payload, len, &coap_class, &coap_detail);
	}

	led_off(LED_LTE);

	if (!err)
	{
		LOG_INF("Message accepted (CoAP %d.%02d)", coap_class, coap_detail);
		led_on_for(LED_SENT, K_SECONDS(CONFIG_APP_SENT_LED_ON_SECONDS));
	}
	else if (err == -ECANCELED)
	{
		LOG_INF("LTE: attach stopped (magnet), nothing sent");
	}
	else
	{
		LOG_ERR("Message not delivered: %d (CoAP %d.%02d)", err, coap_class, coap_detail);
	}

	/* CFUN=0 detaches first; over NTN this takes tens of seconds. */
	LOG_INF("LTE: detaching");
	(void)modem_offline();
	return err;
}

static void run_cycle(unsigned int cycle)
{
	struct gnss_fix fix;
	char payload[PAYLOAD_SIZE];
	int len;
	int err;

	LOG_INF("=== Cycle %u ===", cycle);

	led_blink(LED_GNSS);
	err = gnss_acquire(&fix, CONFIG_APP_GNSS_FIX_TIMEOUT_SECONDS);
	led_off(LED_GNSS);
	if (err == -ECANCELED)
	{
		return;
	}
	if (err)
	{
		LOG_WRN("No GNSS fix: cycle aborted, nothing sent");
		return;
	}

	LOG_INF("GNSS fix: %.6f, %.6f, alt %.1f m, accuracy %.1f m, %u sats, %u s, %s",
			fix.latitude, fix.longitude, (double)fix.altitude, (double)fix.accuracy,
			fix.satellites, (unsigned int)fix.ttff_s, fix.utc);

	/* NTN attach uses the position of this cycle's fix. */
	modem_set_location(fix.latitude, fix.longitude, fix.altitude);

	len = build_payload(payload, sizeof(payload), &fix);
	if (len < 0 || (size_t)len >= sizeof(payload))
	{
		LOG_ERR("Payload too long");
		return;
	}

	(void)send_report(payload, len);
}

/* Modem and LEDs off until the magnet is removed. */
static void standby(void)
{
	LOG_INF("Magnet detected: standby");
	led_off(LED_GNSS);
	led_off(LED_LTE);
	led_off(LED_SENT);
	(void)modem_offline();

	while (magnet_present())
	{
		magnet_wait(K_SECONDS(1));
	}

	LOG_INF("Magnet removed: resuming");
}

/* Sleeps until the absolute uptime 'next', or returns early on a magnet. */
static void sleep_until(int64_t next)
{
	int64_t now;

	while (!magnet_present() && (now = k_uptime_get()) < next)
	{
		magnet_wait(K_MSEC(MIN(next - now, 1000)));
	}
}

int main(void)
{
	unsigned int cycle = 0;
	int err;

	LOG_INF("PiggySat v%s started: report every %d s", APP_VERSION_STRING,
			CONFIG_APP_REPORT_INTERVAL_SECONDS);

	err = antenna_init();
	if (!err)
	{
		err = leds_init();
	}
	if (!err)
	{
		err = magnet_init();
	}
	if (!err)
	{
		err = modem_init();
	}
	if (!err)
	{
		err = transport_init();
	}
	if (err)
	{
		LOG_ERR("Init failed (%d), stopping", err);
		return 0;
	}

	for (;;)
	{
		int64_t next;

		if (magnet_present())
		{
			standby();
			continue; /* magnet removed: start a cycle at once */
		}

		next = k_uptime_get() + CONFIG_APP_REPORT_INTERVAL_SECONDS * 1000LL;
		run_cycle(++cycle);

		/* Fixed period from the start of each cycle; a long cycle starts the next at once. */
		if (!magnet_present())
		{
			LOG_INF("Sleeping until the next cycle");
			sleep_until(next);
		}
	}

	return 0;
}
```

## src/antenna.c
```c
/*
 * SPDX-License-Identifier: Apache-2.0
 */

#include "app.h"

#include <errno.h>

#include <zephyr/drivers/gpio.h>
#include <zephyr/logging/log.h>

LOG_MODULE_REGISTER(antenna, CONFIG_APP_LOG_LEVEL);

/* J3 antenna selection switch: low = LTE, high = GNSS. */
static const struct gpio_dt_spec antenna_switch =
	GPIO_DT_SPEC_GET(DT_NODELABEL(antenna_switch), gpios);

int antenna_init(void)
{
	int err;

	if (!gpio_is_ready_dt(&antenna_switch))
	{
		LOG_ERR("Antenna switch GPIO not ready");
		return -ENODEV;
	}

	/* Start on LTE so the switch control line never floats. */
	err = gpio_pin_configure_dt(&antenna_switch, GPIO_OUTPUT_INACTIVE);
	if (err)
	{
		LOG_ERR("Failed to configure antenna switch GPIO: %d", err);
		return err;
	}

	LOG_INF("Antenna switch initialized: LTE");
	return 0;
}

/* Callers switch only while the modem radio is off (CFUN=0). */
int antenna_select(enum antenna_path path)
{
	int err = gpio_pin_set_dt(&antenna_switch, path == ANTENNA_PATH_GNSS ? 1 : 0);

	if (err)
	{
		LOG_ERR("Failed to set antenna switch: %d", err);
		return err;
	}

	LOG_INF("Antenna switched to %s", path == ANTENNA_PATH_GNSS ? "GNSS" : "LTE");
	return 0;
}
```

## src/app.h
```c
/*
 * SPDX-License-Identifier: Apache-2.0
 */

#ifndef APP_H_
#define APP_H_

#include <stdbool.h>
#include <stddef.h>
#include <stdint.h>

#include <zephyr/kernel.h>

/* antenna.c: J3 antenna selection switch */
enum antenna_path
{
	ANTENNA_PATH_LTE,
	ANTENNA_PATH_GNSS,
};

int antenna_init(void);
int antenna_select(enum antenna_path path);

/* leds.c */
enum led_id
{
	LED_GNSS, /* red */
	LED_LTE,  /* orange */
	LED_SENT, /* green */
};

int leds_init(void);
void led_blink(enum led_id led);
void led_on_for(enum led_id led, k_timeout_t duration);
void led_off(enum led_id led);

/* magnet.c: magnet sensor; a present magnet puts the app in standby */
int magnet_init(void);
bool magnet_present(void);
void magnet_wait(k_timeout_t timeout);

/* gnss.c */
struct gnss_fix
{
	double latitude;
	double longitude;
	float altitude;
	float accuracy;
	uint8_t satellites;
	uint32_t ttff_s;
	char utc[32]; /* "YYYY-MM-DDTHH:MM:SSZ" */
};

int gnss_acquire(struct gnss_fix *fix, int timeout_s);

/* modem.c */
int modem_init(void);
int modem_offline(void);
void modem_set_location(double latitude, double longitude, float altitude);
int lte_configure(void);
int lte_connect_start(void);
int lte_wait_for_link(int timeout_s);
void lte_info_log(void);

/* transport.c */
int transport_init(void);
int transport_send(const char *payload, size_t len, int *coap_class, int *coap_detail);

#endif
```

## src/gnss.c
```c
/*
 * SPDX-License-Identifier: Apache-2.0
 */

#include "app.h"

#include <errno.h>

#include <modem/lte_lc.h>
#include <nrf_modem_gnss.h>
#include <zephyr/logging/log.h>
#include <zephyr/sys/printk.h>
#include <zephyr/sys/util.h>

LOG_MODULE_REGISTER(gnss, CONFIG_APP_LOG_LEVEL);

/* Satellite info is logged every SATS_LOG_PERIOD_S seconds while searching. */
#define SATS_LOG_PERIOD_S 3

/* Filled in the GNSS event handler (interrupt context) when a valid fix arrives. */
static struct nrf_modem_gnss_pvt_data_frame fix_pvt;

/* Latest PVT frame, with or without a fix, for the satellite log. */
static struct nrf_modem_gnss_pvt_data_frame last_pvt;
static bool last_pvt_valid;
static struct k_spinlock pvt_lock;

K_SEM_DEFINE(fix_sem, 0, 1);

static uint8_t sats_count(const struct nrf_modem_gnss_pvt_data_frame *pvt, bool used_only)
{
	uint8_t count = 0;

	for (size_t i = 0; i < ARRAY_SIZE(pvt->sv); i++)
	{
		if (pvt->sv[i].sv == 0)
		{
			continue;
		}
		if (!used_only || (pvt->sv[i].flags & NRF_MODEM_GNSS_SV_FLAG_USED_IN_FIX))
		{
			count++;
		}
	}

	return count;
}

static const char *sv_system(uint8_t signal)
{
	switch (signal)
	{
	case NRF_MODEM_GNSS_SIGNAL_GPS_L1_CA:
		return "GPS";
	case NRF_MODEM_GNSS_SIGNAL_QZSS_L1_CA:
		return "QZSS";
	case NRF_MODEM_GNSS_SIGNAL_GAL_E1_OS:
		return "GAL";
	default:
		return "?";
	}
}

/* Logs the satellites of the latest PVT frame (called from the waiting thread). */
static void sats_log(int64_t start)
{
	struct nrf_modem_gnss_pvt_data_frame pvt;
	k_spinlock_key_t key = k_spin_lock(&pvt_lock);
	bool valid = last_pvt_valid;

	if (valid)
	{
		pvt = last_pvt;
	}
	k_spin_unlock(&pvt_lock, key);

	if (!valid)
	{
		LOG_INF("GNSS: %d s, no satellite data yet", (int)((k_uptime_get() - start) / 1000));
		return;
	}

	LOG_INF("GNSS: %d s, %u satellites tracked, %u used in fix%s%s",
			(int)((k_uptime_get() - start) / 1000), sats_count(&pvt, false), sats_count(&pvt, true),
			(pvt.flags & NRF_MODEM_GNSS_PVT_FLAG_DEADLINE_MISSED) ? ", deadline missed" : "",
			(pvt.flags & NRF_MODEM_GNSS_PVT_FLAG_NOT_ENOUGH_WINDOW_TIME)
				? ", not enough window time"
				: "");

	for (size_t i = 0; i < ARRAY_SIZE(pvt.sv); i++)
	{
		const struct nrf_modem_gnss_sv *sv = &pvt.sv[i];

		if (sv->sv == 0)
		{
			continue;
		}
		LOG_INF("  %-4s %3u  C/N0 %2u.%u dB-Hz  elev %3d deg  azim %3d deg%s%s",
				sv_system(sv->signal), sv->sv, sv->cn0 / 10, sv->cn0 % 10, sv->elevation,
				sv->azimuth, (sv->flags & NRF_MODEM_GNSS_SV_FLAG_USED_IN_FIX) ? "  used" : "",
				(sv->flags & NRF_MODEM_GNSS_SV_FLAG_UNHEALTHY) ? "  unhealthy" : "");
	}
}

static void gnss_event_handler(int event)
{
	struct nrf_modem_gnss_pvt_data_frame pvt;
	k_spinlock_key_t key;

	if (event != NRF_MODEM_GNSS_EVT_PVT)
	{
		return;
	}

	if (nrf_modem_gnss_read(&pvt, sizeof(pvt), NRF_MODEM_GNSS_DATA_PVT) != 0)
	{
		return;
	}

	key = k_spin_lock(&pvt_lock);
	last_pvt = pvt;
	last_pvt_valid = true;
	k_spin_unlock(&pvt_lock, key);

	if (pvt.flags & NRF_MODEM_GNSS_PVT_FLAG_FIX_VALID)
	{
		fix_pvt = pvt;
		k_sem_give(&fix_sem);
	}
}

static int gnss_start(int timeout_s)
{
	int err;

	/* The antenna only switches with the radio off (CFUN=0). */
	err = modem_offline();
	if (!err)
	{
		err = antenna_select(ANTENNA_PATH_GNSS);
	}
	if (!err)
	{
		err = lte_lc_system_mode_set(LTE_LC_SYSTEM_MODE_GPS, LTE_LC_SYSTEM_MODE_PREFER_AUTO);
	}
	if (!err)
	{
		err = lte_lc_func_mode_set(LTE_LC_FUNC_MODE_ACTIVATE_GNSS);
	}
	if (!err)
	{
		err = nrf_modem_gnss_event_handler_set(gnss_event_handler);
	}
	if (!err)
	{
		/* Single fix: the receiver stops by itself after the fix or the timeout. */
		err = nrf_modem_gnss_fix_interval_set(0);
	}
	if (!err)
	{
		err = nrf_modem_gnss_fix_retry_set(timeout_s);
	}
	if (!err)
	{
		k_spinlock_key_t key = k_spin_lock(&pvt_lock);

		last_pvt_valid = false;
		k_spin_unlock(&pvt_lock, key);
		k_sem_reset(&fix_sem);
		err = nrf_modem_gnss_start();
	}

	if (err)
	{
		LOG_ERR("GNSS start failed: %d", err);
	}
	return err;
}

static void gnss_stop(void)
{
	(void)nrf_modem_gnss_stop();
	(void)lte_lc_func_mode_set(LTE_LC_FUNC_MODE_DEACTIVATE_GNSS);
	(void)modem_offline();
}

int gnss_acquire(struct gnss_fix *fix, int timeout_s)
{
	int64_t start = k_uptime_get();
	const struct nrf_modem_gnss_datetime *dt = &fix_pvt.datetime;
	int err;

	LOG_INF("GNSS: searching (timeout %d s)", timeout_s);
	err = gnss_start(timeout_s);
	if (err)
	{
		gnss_stop();
		return err;
	}

	/* Wait in 1 s steps so that a magnet stops the search promptly. */
	err = -ETIMEDOUT;
	for (int t = 0; t < timeout_s + 5; t++)
	{
		if (k_sem_take(&fix_sem, K_SECONDS(1)) == 0)
		{
			err = 0;
			break;
		}
		if (magnet_present())
		{
			err = -ECANCELED;
			break;
		}
		if ((t + 1) % SATS_LOG_PERIOD_S == 0)
		{
			sats_log(start);
		}
	}
	gnss_stop();
	if (err == -ECANCELED)
	{
		LOG_INF("GNSS: search stopped (magnet)");
		return err;
	}
	if (err)
	{
		LOG_WRN("GNSS: no fix within %d s", timeout_s);
		sats_log(start);
		return err;
	}

	fix->latitude = fix_pvt.latitude;
	fix->longitude = fix_pvt.longitude;
	fix->altitude = fix_pvt.altitude;
	fix->accuracy = fix_pvt.accuracy;
	fix->satellites = sats_count(&fix_pvt, true);
	fix->ttff_s = (uint32_t)((k_uptime_get() - start) / 1000);
	snprintk(fix->utc, sizeof(fix->utc), "%04u-%02u-%02uT%02u:%02u:%02uZ", dt->year, dt->month,
			 dt->day, dt->hour, dt->minute, dt->seconds);

	return 0;
}
```

## src/leds.c
```c
/*
 * SPDX-License-Identifier: Apache-2.0
 */

#include "app.h"

#include <errno.h>

#include <zephyr/drivers/gpio.h>
#include <zephyr/logging/log.h>
#include <zephyr/sys/util.h>

LOG_MODULE_REGISTER(leds, CONFIG_APP_LOG_LEVEL);

enum led_mode
{
	LED_MODE_OFF,
	LED_MODE_BLINK,
	LED_MODE_ON_TIMED,
};

struct led
{
	struct gpio_dt_spec gpio;
	struct k_work_delayable work;
	enum led_mode mode;
	bool lit;
};

static struct led leds[] = {
	[LED_GNSS] = {.gpio = GPIO_DT_SPEC_GET(DT_NODELABEL(gnss_led), gpios)},
	[LED_LTE] = {.gpio = GPIO_DT_SPEC_GET(DT_NODELABEL(lte_led), gpios)},
	[LED_SENT] = {.gpio = GPIO_DT_SPEC_GET(DT_NODELABEL(sent_led), gpios)},
};

static void led_set(struct led *led, bool on)
{
	led->lit = on;
	(void)gpio_pin_set_dt(&led->gpio, on ? 1 : 0);
}

/* Blink: toggle and reschedule. Timed on: the work item turns the LED off. */
static void led_work_fn(struct k_work *work)
{
	struct k_work_delayable *dwork = k_work_delayable_from_work(work);
	struct led *led = CONTAINER_OF(dwork, struct led, work);

	if (led->mode == LED_MODE_BLINK)
	{
		led_set(led, !led->lit);
		k_work_schedule(&led->work, K_MSEC(CONFIG_APP_LED_BLINK_MS));
	}
	else
	{
		led->mode = LED_MODE_OFF;
		led_set(led, false);
	}
}

int leds_init(void)
{
	int err;

	for (size_t i = 0; i < ARRAY_SIZE(leds); i++)
	{
		if (!gpio_is_ready_dt(&leds[i].gpio))
		{
			LOG_ERR("LED %u GPIO not ready", (unsigned int)i);
			return -ENODEV;
		}

		err = gpio_pin_configure_dt(&leds[i].gpio, GPIO_OUTPUT_INACTIVE);
		if (err)
		{
			LOG_ERR("Failed to configure LED %u: %d", (unsigned int)i, err);
			return err;
		}

		k_work_init_delayable(&leds[i].work, led_work_fn);
	}

	return 0;
}

static void led_stop(struct led *led)
{
	struct k_work_sync sync;

	led->mode = LED_MODE_OFF;
	(void)k_work_cancel_delayable_sync(&led->work, &sync);
}

void led_blink(enum led_id id)
{
	struct led *led = &leds[id];

	led_stop(led);
	led->mode = LED_MODE_BLINK;
	led_set(led, true);
	k_work_schedule(&led->work, K_MSEC(CONFIG_APP_LED_BLINK_MS));
}

void led_on_for(enum led_id id, k_timeout_t duration)
{
	struct led *led = &leds[id];

	led_stop(led);
	led->mode = LED_MODE_ON_TIMED;
	led_set(led, true);
	k_work_schedule(&led->work, duration);
}

void led_off(enum led_id id)
{
	struct led *led = &leds[id];

	led_stop(led);
	led_set(led, false);
}
```

## src/magnet.c
```c
/*
 * SPDX-License-Identifier: Apache-2.0
 */

#include "app.h"

#include <errno.h>

#include <zephyr/drivers/gpio.h>
#include <zephyr/logging/log.h>

LOG_MODULE_REGISTER(magnet, CONFIG_APP_LOG_LEVEL);

#define MAGNET_EVT_CHANGED BIT(0)

/* Magnet sensor: active (low) = magnet present. */
static const struct gpio_dt_spec magnet = GPIO_DT_SPEC_GET(DT_NODELABEL(magnet_sensor), gpios);
static struct gpio_callback magnet_cb;

K_EVENT_DEFINE(magnet_events);

static void magnet_isr(const struct device *dev, struct gpio_callback *cb, uint32_t pins)
{
	ARG_UNUSED(dev);
	ARG_UNUSED(cb);
	ARG_UNUSED(pins);

	k_event_post(&magnet_events, MAGNET_EVT_CHANGED);
}

int magnet_init(void)
{
	int err;

	if (!gpio_is_ready_dt(&magnet))
	{
		LOG_ERR("Magnet sensor GPIO not ready");
		return -ENODEV;
	}

	err = gpio_pin_configure_dt(&magnet, GPIO_INPUT);
	if (!err)
	{
		gpio_init_callback(&magnet_cb, magnet_isr, BIT(magnet.pin));
		err = gpio_add_callback_dt(&magnet, &magnet_cb);
	}
	if (!err)
	{
		err = gpio_pin_interrupt_configure_dt(&magnet, GPIO_INT_EDGE_BOTH);
	}
	if (err)
	{
		LOG_ERR("Magnet sensor setup failed: %d", err);
	}

	return err;
}

bool magnet_present(void)
{
	return gpio_pin_get_dt(&magnet) > 0;
}

/* Waits up to the timeout, waking early when the sensor changes. Callers read
 * magnet_present() afterwards, so a change that slips between two waits is
 * still seen at the next check.
 */
void magnet_wait(k_timeout_t timeout)
{
	(void)k_event_wait(&magnet_events, MAGNET_EVT_CHANGED, true, timeout);
}
```

## src/modem.c
```c
/*
 * Copyright (c) 2020 Nordic Semiconductor ASA
 *
 * SPDX-License-Identifier: LicenseRef-Nordic-5-Clause
 */

#include "app.h"

#include <errno.h>
#include <stdlib.h>
#include <string.h>

#include <modem/at_parser.h>
#include <modem/lte_lc.h>
#include <modem/modem_info.h>
#include <modem/nrf_modem_lib.h>
#include <modem/ntn.h>
#include <nrf_modem_at.h>
#include <zephyr/logging/log.h>

LOG_MODULE_REGISTER(modem, CONFIG_APP_LOG_LEVEL);

#define MODEM_FW_VERSION_SIZE 128

/* Location given to the modem for NTN: the GNSS fix of the current cycle. */
static double ntn_latitude;
static double ntn_longitude;
static float ntn_altitude;
static bool ntn_location_valid;

static bool lte_registered;
static bool lte_pdn_active;
static struct k_spinlock lte_lock;

K_SEM_DEFINE(lte_link_sem, 0, 1);

static char *first_line(char *text)
{
	char *end;

	while (*text == '\r' || *text == '\n' || *text == ' ')
	{
		text++;
	}
	end = strpbrk(text, "\r\n");
	if (end != NULL)
	{
		*end = '\0';
	}
	return text;
}

static int verify_modem_firmware(void)
{
	char version[MODEM_FW_VERSION_SIZE];
	char *trimmed;
	int err;

	err = nrf_modem_at_cmd(version, sizeof(version), "AT+CGMR");
	if (err)
	{
		LOG_ERR("AT+CGMR failed: %d", err);
		return err;
	}

	trimmed = first_line(version);
	LOG_INF("Modem firmware: %s", trimmed);
	if (strlen(CONFIG_APP_MODEM_FW_EXPECTED) > 0 &&
		strstr(trimmed, CONFIG_APP_MODEM_FW_EXPECTED) == NULL)
	{
		LOG_ERR("Unsupported modem firmware, expected '%s'", CONFIG_APP_MODEM_FW_EXPECTED);
		return -EINVAL;
	}

	return 0;
}

static int ntn_location_update(void)
{
	int err;

	if (!ntn_location_valid)
	{
		LOG_ERR("No GNSS location for NTN");
		return -ENODATA;
	}

	err = ntn_location_set(ntn_latitude, ntn_longitude, ntn_altitude,
							   CONFIG_APP_NTN_LOCATION_VALIDITY_SECONDS);

	if (err)
	{
		LOG_ERR("Failed to set NTN location: %d", err);
	}
	return err;
}

static void ntn_handler(const struct ntn_evt *const evt)
{
	if (evt->type == NTN_EVT_LOCATION_REQUEST && evt->location_request.requested)
	{
		(void)ntn_location_update();
	}
}

static void lte_link_update(void)
{
	bool ready;
	k_spinlock_key_t key = k_spin_lock(&lte_lock);

	ready = lte_registered && lte_pdn_active;
	k_spin_unlock(&lte_lock, key);

	if (ready)
	{
		k_sem_give(&lte_link_sem);
	}
}

static void lte_handler(const struct lte_lc_evt *const evt)
{
	k_spinlock_key_t key;

	switch (evt->type)
	{
	case LTE_LC_EVT_NW_REG_STATUS:
		key = k_spin_lock(&lte_lock);
		lte_registered = evt->nw_reg_status == LTE_LC_NW_REG_REGISTERED_HOME ||
						 evt->nw_reg_status == LTE_LC_NW_REG_REGISTERED_ROAMING;
		if (!lte_registered)
		{
			lte_pdn_active = false;
		}
		k_spin_unlock(&lte_lock, key);
		LOG_INF("Network registration status: %d", evt->nw_reg_status);
		lte_link_update();
		break;
	case LTE_LC_EVT_PDN:
		key = k_spin_lock(&lte_lock);
		if (evt->pdn.type == LTE_LC_EVT_PDN_ACTIVATED || evt->pdn.type == LTE_LC_EVT_PDN_RESUMED)
		{
			lte_pdn_active = true;
		}
		else if (evt->pdn.type != LTE_LC_EVT_PDN_IPV6_UP &&
				 evt->pdn.type != LTE_LC_EVT_PDN_IPV6_DOWN &&
				 evt->pdn.type != LTE_LC_EVT_PDN_APN_RATE_CONTROL_ON &&
				 evt->pdn.type != LTE_LC_EVT_PDN_APN_RATE_CONTROL_OFF)
		{
			lte_pdn_active = false;
		}
		k_spin_unlock(&lte_lock, key);
		LOG_INF("PDN event %d (cid %u)", evt->pdn.type, evt->pdn.cid);
		lte_link_update();
		break;
	case LTE_LC_EVT_CELL_UPDATE:
		LOG_INF("Cell: id=%d tac=%d", evt->cell.id, evt->cell.tac);
		break;
	case LTE_LC_EVT_RRC_UPDATE:
		LOG_INF("RRC %s", evt->rrc_mode == LTE_LC_RRC_MODE_CONNECTED ? "connected" : "idle");
		break;
	default:
		break;
	}
}

int modem_init(void)
{
	int err;

	ntn_register_handler(ntn_handler);

	err = nrf_modem_lib_init();
	if (err)
	{
		LOG_ERR("Modem library init failed: %d", err);
		return err;
	}

	return verify_modem_firmware();
}

int modem_offline(void)
{
	int err = nrf_modem_at_printf("AT+CFUN=0");

	if (err)
	{
		LOG_ERR("AT+CFUN=0 failed: %d", err);
	}
	return err;
}

void modem_set_location(double latitude, double longitude, float altitude)
{
	ntn_latitude = latitude;
	ntn_longitude = longitude;
	ntn_altitude = altitude;
	ntn_location_valid = true;
}

int lte_configure(void)
{
	int err;

	/* The antenna only switches with the radio off (CFUN=0). */
	err = modem_offline();
	if (!err)
	{
		err = antenna_select(ANTENNA_PATH_LTE);
	}
	if (!err)
	{
		err = lte_lc_system_mode_set(LTE_LC_SYSTEM_MODE_NTN_NBIOT, LTE_LC_SYSTEM_MODE_PREFER_AUTO);
	}
	if (!err)
	{
		err = nrf_modem_at_printf("AT%%XBANDLOCK=2,\"\",\"%s\"", CONFIG_APP_BAND_LOCK_LIST);
	}
	if (!err)
	{
		err = nrf_modem_at_printf("AT+CGDCONT=0,\"IP\",\"%s\"", CONFIG_APP_APN);
	}
	if (!err)
	{
		err = ntn_location_update();
	}

	if (err)
	{
		LOG_ERR("NTN configuration failed: %d", err);
	}
	return err;
}

int lte_connect_start(void)
{
	k_spinlock_key_t key = k_spin_lock(&lte_lock);

	lte_registered = false;
	lte_pdn_active = false;
	k_spin_unlock(&lte_lock, key);
	k_sem_reset(&lte_link_sem);

	LOG_INF("LTE: attaching (NTN)");
	return lte_lc_connect_async(lte_handler);
}

/* Waits in 1 s steps so that a magnet stops the attach promptly. */
int lte_wait_for_link(int timeout_s)
{
	for (int t = 0; t < timeout_s; t++)
	{
		if (k_sem_take(&lte_link_sem, K_SECONDS(1)) == 0)
		{
			return 0;
		}
		if (magnet_present())
		{
			return -ECANCELED;
		}
	}

	return -ETIMEDOUT;
}

/* Network details logged once attached, from AT%XMONITOR and AT+CGPADDR.
 *
 * %XMONITOR: <reg_status>[,<full_name>,<short_name>,<plmn>,<tac>,<AcT>,<band>,<cell_id>,
 *            <phys_cell_id>,<EARFCN>,<rsrp>,<snr>,<NW-provided_eDRX_value>,<Active-Time>,
 *            <Periodic-TAU-ext>,<Periodic-TAU>]
 */
#define XMONITOR_RESPONSE_SIZE 384
#define XMONITOR_RSRP_UNKNOWN 255
#define XMONITOR_SNR_UNKNOWN 127

static const char *reg_status_text(int status)
{
	switch (status)
	{
	case LTE_LC_NW_REG_NOT_REGISTERED:
		return "not registered";
	case LTE_LC_NW_REG_REGISTERED_HOME:
		return "registered, home";
	case LTE_LC_NW_REG_SEARCHING:
		return "searching";
	case LTE_LC_NW_REG_REGISTRATION_DENIED:
		return "registration denied";
	case LTE_LC_NW_REG_UNKNOWN:
		return "unknown";
	case LTE_LC_NW_REG_REGISTERED_ROAMING:
		return "registered, roaming";
	case LTE_LC_NW_REG_UICC_FAIL:
		return "UICC failure";
	default:
		return "?";
	}
}

static const char *act_text(int act)
{
	switch (act)
	{
	case LTE_LC_LTE_MODE_LTEM:
		return "LTE-M";
	case LTE_LC_LTE_MODE_NBIOT:
		return "NB-IoT";
	case LTE_LC_LTE_MODE_NTN_NBIOT:
		return "NB-IoT NTN";
	default:
		return "?";
	}
}

/* Copies string field 'index' into buf, or "-" when missing or empty. */
static void at_string(struct at_parser *parser, size_t index, char *buf, size_t size)
{
	size_t len = size;

	if (at_parser_string_get(parser, index, buf, &len) != 0 || buf[0] == '\0')
	{
		snprintk(buf, size, "-");
	}
}

static void ip_address_log(void)
{
	char response[128];
	char ip[64];
	struct at_parser parser;

	/* +CGPADDR: <cid>,"<IPv4>"[,"<IPv6>"] */
	if (nrf_modem_at_cmd(response, sizeof(response), "AT+CGPADDR=0") != 0 ||
		at_parser_init(&parser, response) != 0)
	{
		LOG_INF("  IP address     -");
		return;
	}
	at_string(&parser, 2, ip, sizeof(ip));
	LOG_INF("  IP address     %s", ip);
}

void lte_info_log(void)
{
	char response[XMONITOR_RESPONSE_SIZE];
	char full_name[32];
	char short_name[32];
	char plmn[8];
	char tac[12];
	char cell_id[12];
	char edrx[12];
	char active_time[12];
	char tau_ext[12];
	char tau[12];
	struct at_parser parser;
	int reg_status = -1;
	int act = -1;
	int band = -1;
	int pci = -1;
	int earfcn = -1;
	int rsrp = XMONITOR_RSRP_UNKNOWN;
	int snr = XMONITOR_SNR_UNKNOWN;
	int err;

	err = nrf_modem_at_cmd(response, sizeof(response), "AT%%XMONITOR");
	if (err)
	{
		LOG_WRN("Network info: AT%%XMONITOR failed: %d", err);
		return;
	}

	err = at_parser_init(&parser, response);
	if (!err)
	{
		err = at_parser_num_get(&parser, 1, &reg_status);
	}
	if (err)
	{
		LOG_WRN("Network info: cannot parse: %s", first_line(response));
		return;
	}

	LOG_INF("Network info:");
	LOG_INF("  Registration   %s (%d)", reg_status_text(reg_status), reg_status);
	if (reg_status != LTE_LC_NW_REG_REGISTERED_HOME &&
		reg_status != LTE_LC_NW_REG_REGISTERED_ROAMING)
	{
		return;
	}

	at_string(&parser, 2, full_name, sizeof(full_name));
	at_string(&parser, 3, short_name, sizeof(short_name));
	at_string(&parser, 4, plmn, sizeof(plmn));
	at_string(&parser, 5, tac, sizeof(tac));
	(void)at_parser_num_get(&parser, 6, &act);
	(void)at_parser_num_get(&parser, 7, &band);
	at_string(&parser, 8, cell_id, sizeof(cell_id));
	(void)at_parser_num_get(&parser, 9, &pci);
	(void)at_parser_num_get(&parser, 10, &earfcn);
	(void)at_parser_num_get(&parser, 11, &rsrp);
	(void)at_parser_num_get(&parser, 12, &snr);
	at_string(&parser, 13, edrx, sizeof(edrx));
	at_string(&parser, 14, active_time, sizeof(active_time));
	at_string(&parser, 15, tau_ext, sizeof(tau_ext));
	at_string(&parser, 16, tau, sizeof(tau));

	LOG_INF("  Operator       %s / %s", full_name, short_name);
	/* PLMN = MCC (3 digits) + MNC (2 or 3 digits) */
	if (strlen(plmn) >= 5)
	{
		LOG_INF("  MCC / MNC      %.3s / %s (PLMN %s)", plmn, plmn + 3, plmn);
	}
	else
	{
		LOG_INF("  MCC / MNC      - (PLMN %s)", plmn);
	}
	LOG_INF("  Technology     %s (AcT %d)", act_text(act), act);
	LOG_INF("  Band           %d", band);
	LOG_INF("  EARFCN         %d", earfcn);
	LOG_INF("  Cell ID        %s (%lu)", cell_id, strtoul(cell_id, NULL, 16));
	LOG_INF("  Tracking area  %s (%lu)", tac, strtoul(tac, NULL, 16));
	LOG_INF("  PCI            %d", pci);
	if (rsrp == XMONITOR_RSRP_UNKNOWN)
	{
		LOG_INF("  RSRP           -");
	}
	else
	{
		LOG_INF("  RSRP           %d dBm", RSRP_IDX_TO_DBM(rsrp));
	}
	if (snr == XMONITOR_SNR_UNKNOWN)
	{
		LOG_INF("  SNR            -");
	}
	else
	{
		LOG_INF("  SNR            %d dB", SNR_IDX_TO_DB(snr));
	}
	LOG_INF("  eDRX           %s", edrx);
	LOG_INF("  Active time    %s", active_time);
	LOG_INF("  Periodic TAU   %s (ext %s)", tau, tau_ext);
	ip_address_log();
}
```

## src/transport.c
```c
/*
 * Copyright (c) 2020 Nordic Semiconductor ASA
 *
 * SPDX-License-Identifier: LicenseRef-Nordic-5-Clause
 */

#include "app.h"

#include <errno.h>
#include <string.h>
#include <unistd.h>
#include <arpa/inet.h>
#include <netdb.h>
#include <sys/socket.h>

#include <zephyr/logging/log.h>
#include <zephyr/net/coap.h>
#include <zephyr/net/coap_client.h>
#include <zephyr/sys/printk.h>

LOG_MODULE_REGISTER(transport, CONFIG_APP_LOG_LEVEL);

/* Extra wait on top of the CoAP retransmission sequence before giving up. */
#define COAP_RESPONSE_SLACK_MS 10000U

static struct coap_client coap_client_ctx;
static int16_t coap_response_code;

K_SEM_DEFINE(coap_response_sem, 0, 1);

static struct coap_transmission_parameters coap_tx_params = {
	.ack_timeout = CONFIG_APP_COAP_ACK_TIMEOUT_MS,
#if defined(CONFIG_COAP_RANDOMIZE_ACK_TIMEOUT)
	.ack_random_percent = CONFIG_COAP_ACK_RANDOM_PERCENT,
#endif
	.coap_backoff_percent = CONFIG_COAP_BACKOFF_PERCENT,
	.max_retransmission = CONFIG_APP_COAP_MAX_RETRANSMIT,
};

/* Worst-case time the CoAP client needs for the request and all its retransmissions. */
static uint32_t coap_response_timeout_ms(void)
{
	uint32_t timeout = coap_tx_params.ack_timeout;
	uint32_t total = 0U;

#if defined(CONFIG_COAP_RANDOMIZE_ACK_TIMEOUT)
	timeout = timeout * coap_tx_params.ack_random_percent / 100U;
#endif
	for (uint8_t i = 0U; i <= coap_tx_params.max_retransmission; i++)
	{
		total += timeout;
		timeout = timeout * coap_tx_params.coap_backoff_percent / 100U;
	}

	return total + COAP_RESPONSE_SLACK_MS;
}

static void coap_response_cb(const struct coap_client_response_data *data, void *user_data)
{
	ARG_UNUSED(user_data);

	if (data->result_code >= 0 && !data->last_block)
	{
		return;
	}

	coap_response_code = data->result_code;
	k_sem_give(&coap_response_sem);
}

/* Resolved on every send: the NTN link may come up with a different DNS. */
static int resolve_server(struct sockaddr_storage *addr, socklen_t *addr_len)
{
	const char *host = strlen(CONFIG_APP_THINGSBOARD_IPV4) ? CONFIG_APP_THINGSBOARD_IPV4
														   : CONFIG_APP_THINGSBOARD_HOST;
	struct sockaddr_in *addr4 = (struct sockaddr_in *)addr;
	struct addrinfo hints = {.ai_family = AF_INET, .ai_socktype = SOCK_DGRAM};
	struct addrinfo *result = NULL;
	char port[8];
	int err;

	memset(addr, 0, sizeof(*addr));
	if (inet_pton(AF_INET, host, &addr4->sin_addr) == 1)
	{
		addr4->sin_family = AF_INET;
		addr4->sin_port = htons(CONFIG_APP_THINGSBOARD_PORT);
		*addr_len = sizeof(*addr4);
		return 0;
	}

	snprintk(port, sizeof(port), "%d", CONFIG_APP_THINGSBOARD_PORT);
	err = getaddrinfo(host, port, &hints, &result);
	if (err || result == NULL)
	{
		LOG_ERR("Cannot resolve '%s': %d", host, err);
		return -EHOSTUNREACH;
	}

	memcpy(addr, result->ai_addr, result->ai_addrlen);
	*addr_len = result->ai_addrlen;
	freeaddrinfo(result);
	return 0;
}

int transport_init(void)
{
	int err = coap_client_init(&coap_client_ctx, "thingsboard");

	if (err)
	{
		LOG_ERR("CoAP client init failed: %d", err);
	}
	return err;
}

int transport_send(const char *payload, size_t len, int *coap_class, int *coap_detail)
{
	struct sockaddr_storage addr;
	socklen_t addr_len;
	struct coap_client_request req = {
		.method = COAP_METHOD_POST,
		.confirmable = true,
		.fmt = COAP_CONTENT_FORMAT_APP_JSON,
		.payload = (const uint8_t *)payload,
		.len = len,
		.cb = coap_response_cb,
	};
	int sock;
	int err;

	err = snprintk(req.path, sizeof(req.path), "api/v1/%s/telemetry",
				   CONFIG_APP_THINGSBOARD_ACCESS_TOKEN);
	if (err < 0 || (size_t)err >= sizeof(req.path) || strlen(CONFIG_APP_THINGSBOARD_ACCESS_TOKEN) == 0)
	{
		LOG_ERR("ThingsBoard access token missing or too long");
		return -EINVAL;
	}

	err = resolve_server(&addr, &addr_len);
	if (err)
	{
		return err;
	}

	sock = socket(AF_INET, SOCK_DGRAM, IPPROTO_UDP);
	if (sock < 0)
	{
		err = -errno;
		LOG_ERR("socket() failed: %d", err);
		return err;
	}

	if (connect(sock, (struct sockaddr *)&addr, addr_len) < 0)
	{
		err = -errno;
		LOG_ERR("connect() failed: %d", err);
		goto out;
	}

	LOG_INF("CoAP POST (%u bytes) to api/v1/<token>/telemetry: %s", (unsigned int)len, payload);
	k_sem_reset(&coap_response_sem);
	coap_response_code = -ETIMEDOUT;
	err = coap_client_req(&coap_client_ctx, sock, NULL, &req, &coap_tx_params);
	if (err < 0)
	{
		LOG_ERR("CoAP request failed: %d", err);
		goto out;
	}

	if (k_sem_take(&coap_response_sem, K_MSEC(coap_response_timeout_ms())) != 0)
	{
		LOG_ERR("No CoAP response");
		err = -ETIMEDOUT;
		goto out;
	}

	if (coap_response_code < 0)
	{
		err = coap_response_code;
		goto out;
	}

	*coap_class = (uint16_t)coap_response_code >> 5;
	*coap_detail = (uint16_t)coap_response_code & 0x1f;
	err = *coap_class == 2 ? 0 : -EBADMSG;

out:
	coap_client_cancel_requests(&coap_client_ctx);
	(void)close(sock);
	return err;
}
```
